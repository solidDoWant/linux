## drivers/quectel_mhi/Kconfig
```kconfig
menu "pcie mhi device Drivers"

config PCIE_MHI_QUECTEL
	 tristate "MHI dev net interface for Quectel"
         help
          This modules enables userspace software clients to communicate
          with devices supporting the MHI protocol. Userspace clients
          may open the device nodes exposed by MHI UCI and perform
          read, write and ioctl operations to communicate with the
          attached device.

endmenu
```
